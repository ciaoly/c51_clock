#include "lcd1602.h"

/**
 * 编号	符号	引脚说明	编号	符号	引脚说明
 * 1	VSS	电源地	9	D2	数据
 * 2	VDD	电源正极	10	D3	数据
 * 3	VL	液晶显示偏压	11	D4	数据
 * 4	RS	数据/命令选择	12	D5	数据 1数据/0指令
 * 5	R/W	读/写选择	13	D6	数据 1读/0写
 * 6	E	使能信号	14	D7	数据
 * 7	D0	数据	15	BLA	背光源正极
 * 8	D1	数据	16	BLK	背光源负极
 */

/**
 * 序号	指令	RS	R/W	D7	D6	D5	D4	D3	D2	D1	D0
 * 1	清显示	0	0	0	0	0	0	0	0	0	1		0x01
 * 2	光标返回	0	0	0	0	0	0	0	0	1	*	0x02
 * 3	置输入模式	0	0	0	0	0	0	0	1	I/D	S	0x
 * 4	显示开/关控制	0	0	0	0	0	0	1	D	C	B
 * 5	光标或字符移位	0	0	0	0	0	1	S/C	R/L	*	*
 * 6	置功能	0	0	0	0	1	DL	N	F	*	*
 * 7	置字符发生存贮器地址	0	0	0	1	字符发生存贮器地址
 * 8	置数据存贮器地址	0	0	1	显示数据存贮器地址
 * 9	读忙标志或地址	0	1	BF	计数器地址
 * 10	写数到CGRAM或DDRAM）	1	0	要写的数据内容
 * 11	从CGRAM或DDRAM读数	1	1	读出的数据内容
 */

/**
 * 指令1：清显示，指令码01H,光标复位到地址00H位置。
 * 指令2：光标复位，光标返回到地址00H。
 * 指令3：光标和显示模式设置 I/D：光标移动方向，高电平右移，低电平左移 S:屏幕上所有文字是否左移或者右移。高电平表示有效，低电平则无效。
 * 指令4：显示开关控制。 D：控制整体显示的开与关，高电平表示开显示，低电平表示关显示 C：控制光标的开与关，高电平表示有光标，低电平表示无光标 B：控制光标是否闪烁，高电平闪烁，低电平不闪烁。
 * 指令5：光标或显示移位 S/C：高电平时移动显示的文字，低电平时移动光标。
 * 指令6：功能设置命令 DL：高电平时为8位总线，低电平时为4位总线 N：低电平时为单行显示，高电平时双行显示 F: 低电平时显示5x7的点阵字符，高电平时显示5x10的点阵字符。
 * 指令7：字符发生器RAM地址设置。
 * 指令8：DDRAM地址设置。
 * 指令9：读忙信号和光标地址 BF：为忙标志位，高电平表示忙，此时模块不能接收命令或者数据，如果为低电平表示不忙。
 * 指令10：写数据。
 * 指令11：读数据。
 */

void init_lcd1602()
{
	rw = 0;
	write_lcd1602(0x38, 0);
	write_lcd1602(0x0c, 0);
	write_lcd1602(0x06, 0);
	write_lcd1602(0x01, 0);
}

void write_lcd1602(uchar com, uchar i)
{
	rs = i;
	P0 = com;
	en = 1;
	delay(2);
	en = 0;
	delay(2);
}

void display_lcd1602_byte(uchar h, uchar l, uchar val)
{
	if (h)
		l = l + 0x40;
	write_lcd1602(0x80 + l, 0);
	write_lcd1602(val, 1);
}

void display_lcd1602_text(uchar h, uchar l, uchar *val)
{
	uchar length = 0;
	while ((val[length] != '\0') && (l < 16))
	{
		display_lcd1602_byte(h, l, val[length]);
		length++;
		l++;
	}
}

void delay(uint z)
{
	uint x, y;
	for (x = z; x > 0; x--)
		for (y = 115; y > 0; y--)
			;
}
